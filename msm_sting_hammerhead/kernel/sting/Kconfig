## msm_sting_hammerhead/kernel/sting/Kconfig
```kconfig
config STING
	bool "Detect vulnerabilities in programs"
	depends on EXPERIMENTAL && ARM && PREEMPT && SECURITY_SELINUX
	help
	  STING is a system that detects name resolution vulnerabilities in
	  programs.

	  See http://siis.cse.psu.edu/sting/ for details.
	  If you are unsure how to answer this question, answer N.
```
